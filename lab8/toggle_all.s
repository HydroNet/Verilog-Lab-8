;TASK4 (toggle_all.s)
	GLOBAL 	TOGGLE_ALL
	IMPORT delay_C
	IMPORT Reset_Handler
	IMPORT DELAY

PINSEL0	EQU	0XE002C000	
IO0DIR	EQU	0XE0028008
IO0PIN	EQU	0XE0028000	
DELAY_SWITCH 	EQU	200000
	AREA	myCODE,CODE,READONLY
TOGGLE_ALL
	LDR r4,=PINSEL0	;GPIO
	LDR	r6,=0xFFFF
	LDR	r5,[r4]	;PINSEL0
	AND	r5,r5,r6	;modify bits 8-15
	STR r5,[r4]
	
	LDR r4,=IO0DIR	;I/O
	LDR	r5,[r4]	
	ORR	r5,r5,#0xFF00	;modify bits 8-15 to be output
	STR r5,[r4]
	
	LDR r5,=IO0PIN	;EXECUTE
	LDR	r6,[r5]	
	ORR	r6,r6,#0xFF00	;sends 1 to pins 8-15 to turn off
	STR r6,[r5]

PUSHCHECK			;check if pin 14 is pushed
	LDR	r7,[r4]	;IO0DIR contents
	BIC	r7,r7,#0x4000	;MODIFIES BIT 14 AS INPUT
	STR r7,[r4]
	LDR r6,[r5]	;READS CONTENTS OF IO0PIN
	AND	r8,r6,#0x4000	;READS 14 BIT IN ADDRESS
	CMP	r8,#0x4000	;CHECKS FOR PIN , 1 OFF, 0 ON
	LDR r7,[r4]	;READ CONTENTS IN IO0DIR
	ORR r7,r7,#0x4000	;MODIFY BIT 14 AS OUTPUT
	STR	r7,[r4]
	BEQ	PUSHCHECK
	LDR	r0,=DELAY_SWITCH
STOP1	BL	DELAY	;prevent bouncing
PUSHRELEASE	LDR	r7,[r4]	
	BIC	r7,r7,#0x4000	;MODIFIES BIT 14 AS INPUT
	STR r7,[r4]
	LDR r6,[r5]	;READS CONTENT IN IO0PIN
	AND	r8,r6,#0x4000	;READS 14TH BIT ADDRESS
	CMP	r8,#0x4000	;CHECK PIN 14 , 1 OFF, 0 ON
	LDR r7,[r4]
	ORR r7,r7,#0x4000	;MODIFY PIN 14 TO BE OUTPUT
	STR	r7,[r4]
	BNE	PUSHRELEASE	;WAITS UNTIL BUTTON RELEASED
	LDR	r0,=DELAY_SWITCH
STOP2	BL	DELAY	;prevent bouncing
	LDR	r6,[r5]		;LOOKS AT PINS 8-15
	AND	r8,r6,#0xFF00	
	CMP	r8,#0xFF00	;CHECKS IF LOGIC 1 SENT TO PINS 8-15 I.E. LEDs OFF
STOP3	BNE	TURNOFF
	BIC	r6,r6,#0xFF00	;USES BIC TO MODIFY SO CERTAIN BITS BECOME ZERO WHILE OTHER REMAIN THE SAME
	STR	r6,[r5]
	B	PUSHCHECK

TURNOFF	
	ORR r6,r6,#0xFF00	;USE ORR SO CERTAIN BITS BECOME 1
	STR	r6,[r5]	
	B	PUSHCHECK

STOP	B	STOP
	END
